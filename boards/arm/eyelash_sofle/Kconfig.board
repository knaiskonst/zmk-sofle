## boards/arm/eyelash_sofle/Kconfig.board
```kconfig
#
# Copyright (c) 2024 The ZMK Contributors
# SPDX-License-Identifier: MIT
#

config BOARD_KNAIS_SOFLE_LEFT
    bool "knais_sofle left"
    depends on SOC_NRF52840_QIAA

config BOARD_KNAIS_SOFLE_RIGHT
    bool "knais_sofle right"
    depends on SOC_NRF52840_QIAA
```
